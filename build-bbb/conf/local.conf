## build-bbb/conf/local.conf
```bitbake
#
# Put your user specific configuration data in 'user.conf' since this file is
# managed by git. Only modify the 'local.conf' file for things that are
# required to build the Judo image and will be commited to git.
#
include user.conf

MACHINE = "beaglebone-yocto"
DISTRO = "openavr"

require ${TOPDIR}/../scripts/conf/local-common.conf
```

## build-rpi4/conf/local.conf
```bitbake
MACHINE = "raspberrypi4"
DISTRO = "openavr"

#
# See ../oe/meta-raspberrypi/docs/ipcompliance.md
#
LICENSE_FLAGS_ACCEPTED = "synaptics-killswitch"

require ${TOPDIR}/../scripts/conf/local-common.conf
```
